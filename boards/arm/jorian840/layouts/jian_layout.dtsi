#include <layouts/kgoh/jian/full.dtsi>
#include <physical_layouts.dtsi>

#include "position_map.dtsi"

&layouts_jorian840_position_map{
        jorian840_jian_mapping: jian {
                physical-layout = <&kgoh_jian_full_layout>;

                positions
                = < 0  1  2  3  4  5  6        7  8  9 10 11 12 13>
                , <   14 15 16 17 18 19       20 21 22 23 24 25   >
                , <   26 27 28 29 30 31       32 33 34 35 36 37   >
                , <               38 39 40 41 42 43               >;
        };
};
